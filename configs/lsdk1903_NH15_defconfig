## configs/lsdk1903_NH15_defconfig
```kconfig
CONFIG_TARGET_xspeed=y
CONFIG_TARGET_xspeed_lsdk1903_NH15=y
CONFIG_TARGET_xspeed_lsdk1903_NH15_DEVICE_NH15=y
CONFIG_DEVEL=y
CONFIG_TOOLCHAINOPTS=y
CONFIG_BUSYBOX_CUSTOM=y
CONFIG_ATH_USER_REGD=y
# CONFIG_BUSYBOX_CONFIG_DD is not set
# CONFIG_BUSYBOX_CONFIG_FEATURE_IPV6 is not set
CONFIG_BUSYBOX_CONFIG_FEATURE_TASKSET_FANCY=y
CONFIG_BUSYBOX_CONFIG_FEATURE_TELNET_AUTOLOGIN=y
CONFIG_BUSYBOX_CONFIG_FEATURE_TELNET_TTYPE=y
CONFIG_BUSYBOX_CONFIG_FEATURE_TELNET_WIDTH=y
CONFIG_BUSYBOX_CONFIG_TASKSET=y
CONFIG_BUSYBOX_CONFIG_TELNET=y
# CONFIG_BUSYBOX_DEFAULT_FEATURE_IPV6 is not set
CONFIG_DRIVER_11AC_SUPPORT=y
CONFIG_DRIVER_11N_SUPPORT=y
CONFIG_DRIVER_11W_SUPPORT=y
CONFIG_EXTERNAL_KERNEL_TREE="../lsdk-1903"
# CONFIG_FEED_freifunk is not set
# CONFIG_FEED_luci is not set
# CONFIG_FEED_packages is not set
# CONFIG_FEED_routing is not set
# CONFIG_FEED_telephony is not set
CONFIG_GCC_LIBSSP=y
# CONFIG_IPV6 is not set
CONFIG_KERNEL_DEVMEM=y
# CONFIG_KERNEL_IPV6 is not set
CONFIG_LIBC="glibc"
CONFIG_LIBC_USE_GLIBC=y
# CONFIG_LIBC_USE_MUSL is not set
CONFIG_MTK_APCLI_SUPPORT=y
CONFIG_MTK_ATE_SUPPORT=y
CONFIG_MTK_BACKGROUND_SCAN_SUPPORT=y
CONFIG_MTK_BAND_STEERING=y
CONFIG_MTK_CFG_SUPPORT_FALCON_MURU=y
CONFIG_MTK_CFG_SUPPORT_FALCON_PP=y
CONFIG_MTK_CFG_SUPPORT_FALCON_SR=y
CONFIG_MTK_CFG_SUPPORT_FALCON_TXCMD_DBG=y
CONFIG_MTK_CHIP_MT7915=y
CONFIG_MTK_DBDC_MODE=y
CONFIG_MTK_DEFAULT_5G_PROFILE=y
CONFIG_MTK_DOT11K_RRM_SUPPORT=y
CONFIG_MTK_DOT11R_FT_SUPPORT=y
CONFIG_MTK_DOT11W_PMF_SUPPORT=y
CONFIG_MTK_DOT11_HE_AX=y
CONFIG_MTK_DOT11_N_SUPPORT=y
CONFIG_MTK_DOT11_VHT_AC=y
CONFIG_MTK_FIRST_IF_EEPROM_EFUSE=y
CONFIG_MTK_FIRST_IF_IPAILNA=y
CONFIG_MTK_FIRST_IF_MT7915=y
CONFIG_MTK_GREENAP_SUPPORT=y
CONFIG_MTK_G_BAND_256QAM_SUPPORT=y
CONFIG_MTK_HDR_TRANS_RX_SUPPORT=y
CONFIG_MTK_HDR_TRANS_TX_SUPPORT=y
CONFIG_MTK_ICAP_SUPPORT=y
CONFIG_MTK_IGMP_SNOOP_SUPPORT=y
CONFIG_MTK_INTERWORKING=y
CONFIG_MTK_MAC_REPEATER_SUPPORT=y
CONFIG_MTK_MAP_SUPPORT=y
CONFIG_MTK_MBSS_SUPPORT=y
CONFIG_MTK_MCAST_RATE_SPECIFIC=y
CONFIG_MTK_MT_AP_SUPPORT=m
CONFIG_MTK_MT_DFS_SUPPORT=y
CONFIG_MTK_MT_MAC=y
CONFIG_MTK_MT_STA_SUPPORT=m
CONFIG_MTK_MT_WIFI=y
CONFIG_MTK_MT_WIFI_PATH="mt_wifi"
CONFIG_MTK_MULTI_PROFILE_SUPPORT=y
CONFIG_MTK_MUMIMO_PLATFORM_PERFORMANCE_LEVEL=1
CONFIG_MTK_MUMIMO_SUPPORT=y
CONFIG_MTK_MU_RA_SUPPORT=y
CONFIG_MTK_OWE_SUPPORT=y
CONFIG_MTK_PCIE_ASPM_DYM_CTRL_SUPPORT=y
CONFIG_MTK_RED_SUPPORT=y
CONFIG_MTK_RTMP_FLASH_SUPPORT=y
CONFIG_MTK_RT_FIRST_CARD_EEPROM="efuse"
CONFIG_MTK_RT_FIRST_IF_RF_OFFSET=0xc0000
CONFIG_MTK_SECOND_IF_NONE=y
CONFIG_MTK_SINGLE_SKU=y
CONFIG_MTK_SMART_CARRIER_SENSE_SUPPORT=y
CONFIG_MTK_SPECTRUM_SUPPORT=y
CONFIG_MTK_SUPPORT_OPENWRT=y
CONFIG_MTK_THIRD_IF_NONE=y
CONFIG_MTK_TPC_SUPPORT=y
CONFIG_MTK_TXBF_SUPPORT=y
CONFIG_MTK_UAPSD=y
CONFIG_MTK_VOW_SUPPORT=y
CONFIG_MTK_WDS_SUPPORT=y
CONFIG_MTK_WIFI_BASIC_FUNC=y
CONFIG_MTK_WIFI_DBG_TXCMD=y
CONFIG_MTK_WIFI_DRIVER=y
CONFIG_MTK_WIFI_EAP_FEATURE=y
CONFIG_MTK_WIFI_MT_MAC=y
CONFIG_MTK_WIFI_TWT_SUPPORT=y
CONFIG_MTK_WLAN_SERVICE=y
CONFIG_MTK_WNM_SUPPORT=y
CONFIG_MTK_WPA3_SUPPORT=y
CONFIG_MTK_WSC_INCLUDED=y
CONFIG_MTK_WSC_V2_SUPPORT=y
CONFIG_OPENSSL_ENGINE=y
CONFIG_OPENSSL_WITH_ASM=y
CONFIG_OPENSSL_WITH_CHACHA_POLY1305=y
CONFIG_OPENSSL_WITH_CMS=y
CONFIG_OPENSSL_WITH_DEPRECATED=y
CONFIG_OPENSSL_WITH_ERROR_MESSAGES=y
CONFIG_OPENSSL_WITH_PSK=y
CONFIG_OPENSSL_WITH_SRP=y
CONFIG_OPENSSL_WITH_TLS13=y
CONFIG_PACKAGE_ATH_DFS=y
CONFIG_PACKAGE_MAC80211_DEBUGFS=y
CONFIG_PACKAGE_MAC80211_MESH=y
CONFIG_PACKAGE_ath10k-firmware-qca6174=y
CONFIG_PACKAGE_ath10k-firmware-qca988x=y
CONFIG_PACKAGE_auto-factory=y
CONFIG_PACKAGE_bash=y
CONFIG_PACKAGE_bc=y
CONFIG_PACKAGE_blkid=y
CONFIG_PACKAGE_ca-bundle=y
CONFIG_PACKAGE_canutils=y
CONFIG_PACKAGE_canutils-candump=y
CONFIG_PACKAGE_canutils-cansend=y
CONFIG_PACKAGE_chat=y
CONFIG_PACKAGE_comgt=y
CONFIG_PACKAGE_compiled-tools=y
CONFIG_PACKAGE_coreutils=y
CONFIG_PACKAGE_coreutils-dd=y
CONFIG_PACKAGE_coreutils-sort=y
CONFIG_PACKAGE_coreutils-stty=y
CONFIG_PACKAGE_diffutils=y
CONFIG_PACKAGE_dosfstools=y
CONFIG_PACKAGE_e2fsprogs=y
CONFIG_PACKAGE_eserial=y
CONFIG_PACKAGE_ethtool=y
CONFIG_PACKAGE_fbtest=y
CONFIG_PACKAGE_fdisk=y
CONFIG_PACKAGE_findutils=y
CONFIG_PACKAGE_findutils-find=y
CONFIG_PACKAGE_findutils-locate=y
CONFIG_PACKAGE_findutils-xargs=y
CONFIG_PACKAGE_fio=y
CONFIG_PACKAGE_hostapd=y
CONFIG_PACKAGE_hostapd-common=y
CONFIG_PACKAGE_hostapd-utils=y
CONFIG_PACKAGE_hwclock=y
CONFIG_PACKAGE_i2c-tools=y
CONFIG_PACKAGE_iw=y
CONFIG_PACKAGE_jansson=y
CONFIG_PACKAGE_kmod-AX99100x=y
CONFIG_PACKAGE_kmod-GobiUSBNet_FM150=y
CONFIG_PACKAGE_kmod-ath=y
CONFIG_PACKAGE_kmod-ath10k=y
CONFIG_PACKAGE_kmod-ath9k=y
CONFIG_PACKAGE_kmod-ath9k-common=y
CONFIG_PACKAGE_kmod-cfg80211=y
CONFIG_PACKAGE_kmod-fs-vfat=y
CONFIG_PACKAGE_kmod-fuxi=y
CONFIG_PACKAGE_kmod-input-core=y
# CONFIG_PACKAGE_kmod-ipt-offload is not set
CONFIG_PACKAGE_kmod-mac80211=y
CONFIG_PACKAGE_kmod-marvell_dsa=y
CONFIG_PACKAGE_kmod-motorcomm_phy=y
CONFIG_PACKAGE_kmod-mt_wifi=y
# CONFIG_PACKAGE_kmod-nf-flow is not set
# CONFIG_PACKAGE_kmod-nf-ipt6 is not set
CONFIG_PACKAGE_kmod-nls-base=y
CONFIG_PACKAGE_kmod-nls-cp437=y
CONFIG_PACKAGE_kmod-nls-iso8859-1=y
CONFIG_PACKAGE_kmod-nls-utf8=y
CONFIG_PACKAGE_kmod-scsi-core=y
CONFIG_PACKAGE_kmod-usb-core=y
CONFIG_PACKAGE_kmod-usb-storage=y
CONFIG_PACKAGE_lcm-api-tool=y
CONFIG_PACKAGE_lcm-ldl-tool=y
CONFIG_PACKAGE_libaio=y
CONFIG_PACKAGE_libblkid=y
CONFIG_PACKAGE_libbz2=y
CONFIG_PACKAGE_libcap=y
CONFIG_PACKAGE_libcomerr=y
CONFIG_PACKAGE_libdb47=y
CONFIG_PACKAGE_libe2p=y
CONFIG_PACKAGE_libevent2=y
CONFIG_PACKAGE_libevent2-core=y
CONFIG_PACKAGE_libevent2-pthreads=y
CONFIG_PACKAGE_libext2fs=y
CONFIG_PACKAGE_libf2fs=y
CONFIG_PACKAGE_libfdisk=y
CONFIG_PACKAGE_libffi=y
CONFIG_PACKAGE_libgdbm=y
CONFIG_PACKAGE_libi2c=y
CONFIG_PACKAGE_libkmod=y
CONFIG_PACKAGE_liblzma=y
CONFIG_PACKAGE_libmount=y
CONFIG_PACKAGE_libncurses=y
CONFIG_PACKAGE_libopenssl=y
CONFIG_PACKAGE_libpci=y
CONFIG_PACKAGE_libpcre=y
CONFIG_PACKAGE_libpopt=y
CONFIG_PACKAGE_libreadline=y
CONFIG_PACKAGE_librt=y
CONFIG_PACKAGE_libsmartcols=y
CONFIG_PACKAGE_libsqlite3=y
CONFIG_PACKAGE_libss=y
CONFIG_PACKAGE_libssp=y
CONFIG_PACKAGE_libstdcpp=y
CONFIG_PACKAGE_libtirpc=y
CONFIG_PACKAGE_libusb-1.0=y
CONFIG_PACKAGE_libuuid=y
CONFIG_PACKAGE_libuv=y
CONFIG_PACKAGE_libwebsockets-full=y
CONFIG_PACKAGE_libwrap=y
CONFIG_PACKAGE_lsblk=y
CONFIG_PACKAGE_lscpu=y
CONFIG_PACKAGE_lsscsi=y
CONFIG_PACKAGE_mkf2fs=y
CONFIG_PACKAGE_mount-utils=y
CONFIG_PACKAGE_nfs-utils=y
CONFIG_PACKAGE_ntpdate=y
CONFIG_PACKAGE_partclone=y
CONFIG_PACKAGE_parted=y
CONFIG_PACKAGE_pciutils=y
CONFIG_PACKAGE_pigz=y
CONFIG_PACKAGE_python3=y
CONFIG_PACKAGE_python3-asyncio=y
CONFIG_PACKAGE_python3-base=y
CONFIG_PACKAGE_python3-cgi=y
CONFIG_PACKAGE_python3-cgitb=y
CONFIG_PACKAGE_python3-codecs=y
CONFIG_PACKAGE_python3-ctypes=y
CONFIG_PACKAGE_python3-dbm=y
CONFIG_PACKAGE_python3-decimal=y
CONFIG_PACKAGE_python3-distutils=y
CONFIG_PACKAGE_python3-email=y
CONFIG_PACKAGE_python3-gdbm=y
CONFIG_PACKAGE_python3-light=y
CONFIG_PACKAGE_python3-logging=y
CONFIG_PACKAGE_python3-lzma=y
CONFIG_PACKAGE_python3-multiprocessing=y
CONFIG_PACKAGE_python3-ncurses=y
CONFIG_PACKAGE_python3-openssl=y
CONFIG_PACKAGE_python3-pydoc=y
CONFIG_PACKAGE_python3-sqlite3=y
CONFIG_PACKAGE_python3-unittest=y
CONFIG_PACKAGE_python3-urllib=y
CONFIG_PACKAGE_python3-xml=y
CONFIG_PACKAGE_sgdisk=y
CONFIG_PACKAGE_smartmontools=y
CONFIG_PACKAGE_sshpass=y
CONFIG_PACKAGE_terminfo=y
CONFIG_PACKAGE_ttyd=y
CONFIG_PACKAGE_uboot-envtools=y
CONFIG_PACKAGE_usbutils=y
CONFIG_PACKAGE_vendor_info=y
CONFIG_PACKAGE_wget=y
CONFIG_PACKAGE_wifi-profile=y
CONFIG_PACKAGE_wireless-regdb=y
CONFIG_PACKAGE_wireless-tools=y
CONFIG_PACKAGE_wpa-supplicant=y
CONFIG_PACKAGE_xz-utils=y
CONFIG_PACKAGE_yt-led-tool=y
CONFIG_PACKAGE_yt-mac-tool=y
CONFIG_PACKAGE_zlib=y
CONFIG_STRIP_ARGS="--strip-all"
CONFIG_TARGET_ROOTFS_CPIOGZ=y
# CONFIG_TARGET_ROOTFS_EXT4FS is not set
# CONFIG_TARGET_ROOTFS_SQUASHFS is not set
# CONFIG_TARGET_ROOTFS_TARGZ is not set
# CONFIG_TARGET_ROOTFS_UBIFS is not set
CONFIG_TARGET_SUFFIX="gnu"
CONFIG_USE_GLIBC=y
CONFIG_USE_LIBSTDCXX=y
CONFIG_USE_STRIP=y
# CONFIG_USE_UCLIBCXX is not set
CONFIG_WIFI_NORMAL_SETTING=y
CONFIG_WPA_MSG_MIN_PRIORITY=3
CONFIG_first_card=y
CONFIG_first_card_EEPROM_name="e2p"
CONFIG_first_card_EEPROM_offset="0x0"
CONFIG_first_card_EEPROM_size="0x20000"
CONFIG_first_card_apcli_ifname="apcli;apclix"
CONFIG_first_card_bf_sku_path="/etc/wireless/mediatek/mt7615e-sku-bf.dat"
CONFIG_first_card_ext_ifname="ra;rax"
CONFIG_first_card_init_compatible="mt7615e;mt7615e"
CONFIG_first_card_init_script="/lib/wifi/mt7615e.lua;/lib/wifi/mt7615e.lua"
CONFIG_first_card_main_ifname="ra0;rax0"
CONFIG_first_card_mesh_ifname="mesh;meshx"
CONFIG_first_card_name="MT7915D"
CONFIG_first_card_nvram_zone="dev1;dev2"
CONFIG_first_card_profile_path="/etc/wireless/mediatek/mt7915.dbdc.b0.dat;/etc/wireless/mediatek/mt7915.dbdc.b1.dat"
CONFIG_first_card_single_sku_path="/etc/wireless/mediatek/mt7615e-sku.dat"
CONFIG_first_card_wds_ifname="wds;wdsx"
# CONFIG_ATH10K_LEDS is not set
CONFIG_PACKAGE_libip6tc=y
# CONFIG_SQLITE3_DYNAMIC_EXTENSIONS is not set
# CONFIG_SQLITE3_FTS3 is not set
# CONFIG_SQLITE3_FTS5 is not set
# CONFIG_SQLITE3_JSON1 is not set
# CONFIG_SQLITE3_RTREE is not set
```
